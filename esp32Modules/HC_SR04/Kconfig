## esp32Modules/HC_SR04/Kconfig
```kconfig
menu "HC_SR04 Ultra Sonic Config"
  config TRIGGER_PIN
    int "trigger_pin"
    range 1 100
    default 5
    help
      Trigger Pin

  config ECHO_PIN
    int "echo_pin"
    range 1 100
    default 18
    help
      Echo Pin

  config MAX_DISTANCE
    int "max_distance"
    range 1 1000
    default 100
    help
      Max Distance
endmenu
```

## esp32Modules/http_server/Kconfig
```kconfig
menu "HTTP Server"
  config WIFI_SSID
    string "wifi_ssid"
    default "NaN"
  
  config WIFI_PASSWORD
    string "wifi_password"
    default "password"

  config HTTP_SERVER_PORT
    int "http_server_port"
    range 1 65536
    default 80
    help
      Port of http server

    config HTTP_MAX_CBS
      int "http_max_cbs"
      range 1 32
      default 4
      help
	Max number of http call backs
endmenu 
```

## recycleBin/MEME_ETH_LAB/extern_packages/ethraw/Config.in
```kconfig
config BR2_PACKAGE_ETHRAW
    bool "ethraw"
    default y
    help
     Enter short description here
```

## recycleBin/MEME_ETH_LAB/extern_packages/kdbhelper/Config.in
```kconfig
config BR2_PACKAGE_KDBHELPER
    bool "kdbhelper"
    depends on BR2_LINUX_KERNEL
    default y
    help
     Enter short description here
```

## recycleBin/MEME_ETH_LAB/extern_packages/v2p/Config.in
```kconfig
config BR2_PACKAGE_V2P
    bool "v2p"
    depends on BR2_LINUX_KERNEL
    default y
    help
     Enter short description here
```
